/dts-v1/;
/plugin/;

/{ /* this is our device tree overlay root node */

	compatible = "ti,beaglebone", "ti,beaglebone-black";
	part-number = "BBB-I2C1"; // you can choose any name here but it should be memorable
 	version = "00A0";

    fragment@1 {
        target = <&i2c2>;

        __overlay__ {
            bu27034: bu27034@38 {
                compatible = "rohm,bu27034anuc";
                reg = <0x38>;
            };
        };
    };
}; /* root node end */
